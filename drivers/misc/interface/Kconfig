## drivers/misc/interface/Kconfig
```kconfig
config GPIO_INTERFACE
        tristate "Enable the Camera & LCD interface for GPIOs"
        default y
        help
            Common GPIO interface for X4.

config GPIO_INTERFACE_PWM
	tristate "Enable PWM function for interface board"
	default y
	help
	    Common PWM interface for x4.
```
